## board/phytec/mx7d_phyboard_zeta/Kconfig
```kconfig
if TARGET_MX7D_PHYBOARD_ZETA

config SYS_BOARD
	default "mx7d_phyboard_zeta"

config SYS_VENDOR
	default "phytec"

config SYS_CONFIG_NAME
	default "mx7d_phyboard_zeta"

endif
```

## configs/mx7d_pcm061_2110111c_defconfig
```kconfig
CONFIG_SYS_EXTRA_OPTIONS="IMX_CONFIG=board/phytec/mx7d_phyboard_zeta/imximage_mt41k256m16tw-107it.cfg, CONFIG_PHYTEC_MT41K256M16TW107IT,FDT=imx7d-phyboard-zeta-001"
CONFIG_ARM=y
CONFIG_ARCH_MX7=y
CONFIG_TARGET_MX7D_PHYBOARD_ZETA=y
CONFIG_IMX_RDC=y
CONFIG_IMX_BOOTAUX=y
CONFIG_SYS_MALLOC_F=y
CONFIG_SYS_MALLOC_F_LEN=0x400
```

## configs/mx7d_pcm061_21x_defconfig
```kconfig
CONFIG_ARM=y
CONFIG_ARCH_MX7=y
CONFIG_TARGET_MX7D_PHYBOARD_ZETA=y
#CONFIG_ARMV7_BOOT_SEC_DEFAULT=y
CONFIG_ARMV7_PSCI=y
CONFIG_ARMV7_PSCI_NR_CPUS=2
CONFIG_IMX_RDC=y
CONFIG_IMX_BOOTAUX=y
CONFIG_DEFAULT_DEVICE_TREE="imx7d-phyboard-zeta-001"
CONFIG_SYS_EXTRA_OPTIONS="IMX_CONFIG=board/phytec/mx7d_phyboard_zeta/imximage_mt41k256m16tw-107it.cfg,PHYTEC_MT41K256M16TW107IT"
CONFIG_BOOTDELAY=3
CONFIG_VIDEO=y
# CONFIG_CONSOLE_MUX is not set
CONFIG_SYS_CONSOLE_IS_IN_ENV=y
CONFIG_HUSH_PARSER=y
CONFIG_CMD_BOOTZ=y
CONFIG_CMD_IMI=y
# CONFIG_CMD_IMLS is not set
# CONFIG_CMD_XIMG is not set
# CONFIG_CMD_EXPORTENV is not set
# CONFIG_CMD_IMPORTENV is not set
CONFIG_CMD_MEMTEST=y
CONFIG_CMD_MMC=y
CONFIG_CMD_SF=y
CONFIG_CMD_I2C=y
CONFIG_CMD_USB=y
CONFIG_CMD_DFU=y
CONFIG_CMD_GPIO=y
CONFIG_CMD_DHCP=y
CONFIG_CMD_MII=y
CONFIG_CMD_PING=y
CONFIG_CMD_CACHE=y
CONFIG_CMD_PMIC=y
CONFIG_CMD_REGULATOR=y
CONFIG_CMD_EXT2=y
CONFIG_CMD_EXT4=y
CONFIG_CMD_EXT4_WRITE=y
CONFIG_CMD_FAT=y
CONFIG_OF_CONTROL=y
# CONFIG_BLK is not set
CONFIG_DFU_MMC=y
CONFIG_DFU_RAM=y
CONFIG_DM_GPIO=y
CONFIG_DM_74X164=y
CONFIG_DM_I2C=y
CONFIG_DM_MMC=y
# CONFIG_DM_MMC_OPS is not set
CONFIG_SPI_FLASH=y
CONFIG_SPI_FLASH_EON=y
CONFIG_PINCTRL=y
CONFIG_PINCTRL_IMX7=y
CONFIG_DM_PMIC=y
CONFIG_DM_PMIC_PFUZE100=y
CONFIG_DM_REGULATOR=y
CONFIG_DM_REGULATOR_PFUZE100=y
CONFIG_DM_REGULATOR_FIXED=y
CONFIG_DM_REGULATOR_GPIO=y
CONFIG_DM_SPI=y
CONFIG_SOFT_SPI=y
CONFIG_USB=y
CONFIG_DM_USB=y
CONFIG_USB_EHCI_HCD=y
CONFIG_MXC_USB_OTG_HACTIVE=y
CONFIG_USB_STORAGE=y
CONFIG_USB_GADGET=y
CONFIG_CI_UDC=y
CONFIG_USB_GADGET_DOWNLOAD=y
CONFIG_G_DNL_MANUFACTURER="FSL"
CONFIG_G_DNL_VENDOR_NUM=0x0525
CONFIG_G_DNL_PRODUCT_NUM=0xa4a5
CONFIG_ERRNO_STR=y
CONFIG_DM_ETH=y
CONFIG_DM_SPI_FLASH=y
CONFIG_FSL_QSPI=y
CONFIG_FIT=y
#CONFIG_FIT_SIGNATURE=y
```

## configs/mx7d_phyboard_defconfig
```kconfig
CONFIG_SYS_EXTRA_OPTIONS="IMX_CONFIG=board/phytec/mx7d_phyboard/imximage.cfg,MX7D"
CONFIG_ARM=y
CONFIG_TARGET_MX7D_PHYBOARD=y
CONFIG_SYS_MALLOC_F=y
CONFIG_SYS_MALLOC_F_LEN=0x400
CONFIG_DM=y
CONFIG_DM_THERMAL=y
```

## configs/mx7d_phyboard_zeta_defconfig
```kconfig
CONFIG_SYS_EXTRA_OPTIONS="IMX_CONFIG=board/phytec/mx7d_phyboard_zeta/imximage.cfg"
CONFIG_ARM=y
CONFIG_ARCH_MX7=y
CONFIG_TARGET_MX7D_PHYBOARD_ZETA=y
CONFIG_IMX_RDC=y
CONFIG_IMX_BOOTAUX=y
CONFIG_SYS_MALLOC_F=y
CONFIG_SYS_MALLOC_F_LEN=0x400
```

## configs/mx7s_pcm061_0502100e_a0_defconfig
```kconfig
CONFIG_SYS_EXTRA_OPTIONS="IMX_CONFIG=board/phytec/mx7d_phyboard_zeta/imximage_mt41k64m16tw-107it.cfg,PHYTEC_MT41K64M16TW107IT,CONFIG_SYS_USE_NAND"
CONFIG_ARM=y
CONFIG_ARCH_MX7=y
CONFIG_TARGET_MX7D_PHYBOARD_ZETA=y
CONFIG_IMX_RDC=y
CONFIG_IMX_BOOTAUX=y
CONFIG_SYS_MALLOC_F=y
CONFIG_SYS_MALLOC_F_LEN=0x400
```

## configs/mx7s_pcm061_0502100e_nand_defconfig
```kconfig
CONFIG_ARM=y
CONFIG_ARCH_MX7=y
CONFIG_TARGET_MX7D_PHYBOARD_ZETA=y
CONFIG_IMX_RDC=y
CONFIG_IMX_BOOTAUX=y
CONFIG_SYS_EXTRA_OPTIONS="IMX_CONFIG=board/phytec/mx7d_phyboard_zeta/imximage_mt41k64m16tw-107it.cfg,PHYTEC_MT41K64M16TW107IT,FDT=imx7s-phyboard-zeta-002,SYS_BOOT_NAND"
```
